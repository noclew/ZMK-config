## config/boards/shields/naansplit/Kconfig.shield
```kconfig
# Copyright (c) 2020 Ryan Cross
# SPDX-License-Identifier: MIT

config SHIELD_NAANSPLIT_LEFT
	def_bool $(shields_list_contains,naansplit_left)

config SHIELD_NAANSPLIT_RIGHT
	def_bool $(shields_list_contains,naansplit_right)
```

## config/boards/shields/vananasplit/Kconfig.shield
```kconfig
# Copyright (c) 2020 Ryan Cross
# SPDX-License-Identifier: MIT

config SHIELD_VANANASPLIT_LEFT
	def_bool $(shields_list_contains,vananasplit_left)

config SHIELD_VANANASPLIT_RIGHT
	def_bool $(shields_list_contains,vananasplit_right)
```
